## CMakeLists.txt
```
# SPDX-License-Identifier: Apache-2.0

cmake_minimum_required(VERSION 3.20.0)

find_package(Zephyr REQUIRED HINTS $ENV{ZEPHYR_BASE})
project(dualsense_bt_host)

target_sources(app PRIVATE
	src/main.c
	src/hid_host.c
	src/dualsense.c
	src/link.c
)
```

## prj.conf
```kconfig
# Bluetooth Classic (BR/EDR) host. DualSense / DualSense Edge are BR/EDR-only
# HID devices, so this needs a dual-mode radio (original ESP32, not S3/C3).
CONFIG_BT=y
CONFIG_BT_CLASSIC=y
CONFIG_BT_DEVICE_NAME="ESP32 DualSense Host"
# Class of Device: Computer / Desktop workstation
CONFIG_BT_COD=0x000104

# Persist the link key in flash, so a paired controller can reconnect with
# the PS button after the ESP32 reboots.
CONFIG_BT_SETTINGS=y
CONFIG_SETTINGS=y
CONFIG_FLASH=y
CONFIG_FLASH_MAP=y
CONFIG_NVS=y

CONFIG_LOG=y
# Deferred logging keeps the UART out of the Bluetooth RX context, but by
# default the log thread only wakes up once a second or every 10 messages.
# Wake it up for every message, so controller events show up right away.
CONFIG_LOG_PROCESS_TRIGGER_THRESHOLD=1
# Room for bursts of stick/trigger updates
CONFIG_LOG_BUFFER_SIZE=4096
CONFIG_ESP32_USE_UNSUPPORTED_REVISION=y

# HCI commands are issued from the system workqueue and input reports are
# parsed and printed from the Bluetooth RX context.
CONFIG_MAIN_STACK_SIZE=4096
CONFIG_SYSTEM_WORKQUEUE_STACK_SIZE=4096
CONFIG_BT_RX_STACK_SIZE=4096
```

## app.overlay
```dts
/*
 * UART2 carries the controller state to the emulator board.
 *
 * The board files already give uart2 its pins (GPIO17 = TX, GPIO16 = RX on a
 * DevKitC, both free on a WROOM-32 - unlike uart1's default GPIO9/GPIO10, which
 * belong to the SPI flash), so only the speed and the status are set here.
 *
 * SPDX-License-Identifier: Apache-2.0
 */

&uart2 {
	status = "okay";
	current-speed = <460800>;
};
```

## src/main.c
```c
/*
 * Bluetooth Classic host for a DualSense / DualSense Edge controller.
 *
 * - First use: put the controller in pairing mode (hold CREATE + PS until the
 *   light bar blinks). It is found by inquiry, paired and bonded.
 * - Later on: press PS, the bonded controller connects back on its own.
 *
 * Every button press/release is printed on the console.
 *
 * SPDX-License-Identifier: Apache-2.0
 */

#include <zephyr/kernel.h>
#include <zephyr/logging/log.h>
#include <zephyr/settings/settings.h>
#include <zephyr/sys/atomic.h>
#include <zephyr/bluetooth/bluetooth.h>
#include <zephyr/bluetooth/addr.h>
#include <zephyr/bluetooth/assigned_numbers.h>
#include <zephyr/bluetooth/conn.h>
#include <zephyr/bluetooth/hci.h>
#include <zephyr/bluetooth/classic/classic.h>

#include "dualsense.h"
#include "hid_host.h"
#include "link.h"

LOG_MODULE_REGISTER(main, LOG_LEVEL_INF);

/*
 * An inquiry keeps the radio busy and leaves page scan little air time, while
 * a bonded controller only pages us for a few seconds after a PS press. Hence
 * the inquiry runs in short bursts, with the air left clear for incoming
 * connections in between.
 */
/* Inquiry length in 1.28 s units */
#define INQUIRY_LENGTH        3
/* Past the end of the inquiry, to also cut the name requests following it */
#define INQUIRY_DURATION      K_MSEC(INQUIRY_LENGTH * 1280 + 200)
#define INQUIRY_PAUSE         K_SECONDS(5)
#define SCAN_RETRY_DELAY      K_SECONDS(1)
#define DISCOVERY_RESULTS_MAX 8

/* Let the stack finish the post-connection feature exchange first */
#define HID_OPEN_DELAY          K_MSEC(250)
/*
 * A reconnecting controller opens the HID channels itself, only step in when
 * it did not.
 */
#define HID_OPEN_FALLBACK_DELAY K_SECONDS(3)

/* Only the low nibble of the peripheral minor class is the device type */
#define COD_PERIPHERAL_DEVICE_TYPE_MASK 0x0f

static struct bt_br_discovery_result discovery_results[DISCOVERY_RESULTS_MAX];

static struct bt_conn *pad_conn;

/* Outgoing connection to 'candidate' is in progress */
static atomic_t connecting;
static bt_addr_t candidate;

static bool inquiry_active;

static void scan_work_handler(struct k_work *work);
static void connect_work_handler(struct k_work *work);
static void hid_open_work_handler(struct k_work *work);

static K_WORK_DELAYABLE_DEFINE(scan_work, scan_work_handler);
static K_WORK_DEFINE(connect_work, connect_work_handler);
static K_WORK_DELAYABLE_DEFINE(hid_open_work, hid_open_work_handler);

static bool cod_is_gamepad(const uint8_t cod[3])
{
	return BT_COD_MAJOR_DEVICE_CLASS(cod) == BT_COD_MAJOR_DEVICE_CLASS_PERIPHERAL &&
	       (BT_COD_MINOR_DEVICE_CLASS(cod) & COD_PERIPHERAL_DEVICE_TYPE_MASK) ==
		       BT_COD_MINOR_DEVICE_CLASS_PERIPHERAL_DEVICE_TYPE_GAMEPAD;
}

static void inquiry_stop(void)
{
	/* Cancels the pending remote name requests as well */
	bt_br_discovery_stop();
	inquiry_active = false;
}

/* Alternates between an inquiry burst and a page scan only pause */
static void scan_work_handler(struct k_work *work)
{
	const struct bt_br_discovery_param param = {
		.length = INQUIRY_LENGTH,
		.limited = false,
	};
	int err;

	if (pad_conn || atomic_get(&connecting)) {
		return;
	}

	if (inquiry_active) {
		inquiry_stop();
		k_work_reschedule(&scan_work, INQUIRY_PAUSE);
		return;
	}

	err = bt_br_discovery_start(&param, discovery_results, ARRAY_SIZE(discovery_results));
	if (err && err != -EALREADY) {
		LOG_ERR("Failed to start discovery (err %d)", err);
		k_work_reschedule(&scan_work, INQUIRY_PAUSE);
		return;
	}

	inquiry_active = true;
	k_work_reschedule(&scan_work, INQUIRY_DURATION);
}

static void discovery_recv(const struct bt_br_discovery_result *result)
{
	if (pad_conn || !cod_is_gamepad(result->cod)) {
		return;
	}

	/* The same device is reported several times (RSSI, EIR, name) */
	if (!atomic_cas(&connecting, 0, 1)) {
		return;
	}

	bt_addr_copy(&candidate, &result->addr);
	k_work_submit(&connect_work);
}

static struct bt_br_discovery_cb discovery_cb = {
	.recv = discovery_recv,
};

static void connect_work_handler(struct k_work *work)
{
	char addr[BT_ADDR_STR_LEN];
	struct bt_conn *conn;

	bt_addr_to_str(&candidate, addr, sizeof(addr));
	LOG_INF("Found controller %s, connecting", addr);

	inquiry_stop();

	/*
	 * A controller in pairing mode has dropped its old link key, so a bond
	 * we may still hold for it would only make the authentication fail.
	 * A bond with another controller has to go as well: a single controller
	 * is served and the link key pool (CONFIG_BT_MAX_PAIRED) has one slot.
	 */
	bt_br_unpair(BT_ADDR_ANY);

	conn = bt_conn_create_br(&candidate, BT_BR_CONN_PARAM_DEFAULT);
	if (!conn) {
		LOG_ERR("Failed to create connection to %s", addr);
		atomic_clear(&connecting);
		k_work_reschedule(&scan_work, SCAN_RETRY_DELAY);
		return;
	}

	/* The reference is taken in connected() for both connection directions */
	bt_conn_unref(conn);
}

static void hid_open_work_handler(struct k_work *work)
{
	struct bt_conn *conn;
	int err;

	if (!pad_conn || !hid_host_is_idle()) {
		return;
	}

	conn = bt_conn_ref(pad_conn);

	err = hid_host_connect(conn);
	if (err) {
		LOG_ERR("Failed to open HID channels (err %d)", err);
		bt_conn_disconnect(conn, BT_HCI_ERR_REMOTE_USER_TERM_CONN);
	}

	bt_conn_unref(conn);
}

static enum bt_br_conn_req_rsp conn_request(const bt_addr_t *addr, uint32_t cod)
{
	char addr_str[BT_ADDR_STR_LEN];

	bt_addr_to_str(addr, addr_str, sizeof(addr_str));
	LOG_INF("Connection request from %s (CoD 0x%06x)", addr_str, cod);

	return BT_BR_CONN_REQ_ACCEPT_PERIPHERAL;
}

/*
 * Page scan lets a bonded controller reconnect with the PS button. It is only
 * needed while no controller is connected, and would take air time from the
 * active link otherwise.
 */
static int page_scan_enable(bool enable)
{
	int err;

	err = bt_br_set_connectable(enable, conn_request);
	if (err == -EALREADY) {
		return 0;
	}

	if (err) {
		LOG_ERR("Failed to %s page scan (err %d)", enable ? "enable" : "disable", err);
	}

	return err;
}

static void connected(struct bt_conn *conn, uint8_t err)
{
	const bt_addr_t *dst = bt_conn_get_dst_br(conn);
	char addr[BT_ADDR_STR_LEN];
	bool outgoing;

	if (!dst) {
		/* Not a BR/EDR connection */
		return;
	}

	bt_addr_to_str(dst, addr, sizeof(addr));

	outgoing = atomic_get(&connecting) && bt_addr_eq(dst, &candidate);
	if (outgoing) {
		atomic_clear(&connecting);
	}

	if (err) {
		LOG_WRN("Connection to %s failed (err 0x%02x)", addr, err);
		if (outgoing) {
			k_work_reschedule(&scan_work, SCAN_RETRY_DELAY);
		}
		return;
	}

	if (pad_conn) {
		LOG_WRN("Already serving a controller, dropping %s", addr);
		bt_conn_disconnect(conn, BT_HCI_ERR_REMOTE_USER_TERM_CONN);
		return;
	}

	LOG_INF("Connected to %s (%s)", addr, outgoing ? "outgoing" : "incoming");

	pad_conn = bt_conn_ref(conn);
	dualsense_reset();

	/* An incoming connection may arrive in the middle of an inquiry */
	inquiry_stop();
	page_scan_enable(false);

	k_work_reschedule(&hid_open_work, outgoing ? HID_OPEN_DELAY : HID_OPEN_FALLBACK_DELAY);
}

static void disconnected(struct bt_conn *conn, uint8_t reason)
{
	if (conn != pad_conn) {
		return;
	}

	LOG_INF("Controller disconnected (reason 0x%02x)", reason);

	k_work_cancel_delayable(&hid_open_work);

	bt_conn_unref(pad_conn);
	pad_conn = NULL;
	dualsense_reset();

	page_scan_enable(true);

	/* The controller is bonded now, so expect it to connect back first */
	k_work_reschedule(&scan_work, INQUIRY_PAUSE);
}

static void security_changed(struct bt_conn *conn, bt_security_t level, enum bt_security_err err)
{
	if (conn != pad_conn) {
		return;
	}

	if (err) {
		LOG_WRN("Security failed (level %d, err %d)", level, err);
		return;
	}

	LOG_INF("Link secured (level %d)", level);
}

BT_CONN_CB_DEFINE(conn_callbacks) = {
	.connected = connected,
	.disconnected = disconnected,
	.security_changed = security_changed,
};

static void hid_ready(void)
{
	int err;

	LOG_INF("Controller ready, waiting for button presses");

	err = dualsense_enable_full_report();
	if (err) {
		LOG_WRN("Failed to request the full input report (err %d)", err);
	}
}

static void hid_closed(void)
{
	/* HID is all the link is used for */
	if (pad_conn) {
		bt_conn_disconnect(pad_conn, BT_HCI_ERR_REMOTE_USER_TERM_CONN);
	}
}

static const struct hid_host_cb hid_callbacks = {
	.ready = hid_ready,
	.input_report = dualsense_handle_input_report,
	.closed = hid_closed,
};

int main(void)
{
	int err;

	link_init();

	err = bt_enable(NULL);
	if (err) {
		LOG_ERR("Bluetooth init failed (err %d)", err);
		return 0;
	}

	if (IS_ENABLED(CONFIG_BT_SETTINGS)) {
		settings_load();
	}

	err = hid_host_init(&hid_callbacks);
	if (err) {
		LOG_ERR("HID host init failed (err %d)", err);
		return 0;
	}

	err = page_scan_enable(true);
	if (err) {
		return 0;
	}

	/*
	 * A reconnecting controller pages for a few seconds only, the default
	 * 11 ms window every 1.28 s is easy to miss.
	 */
	err = bt_br_page_scan_update_param(BT_BR_PAGE_SCAN_PARAM_FAST_R1);
	if (err) {
		LOG_WRN("Failed to speed up page scan (err %d)", err);
	}

	bt_br_discovery_cb_register(&discovery_cb);

	LOG_INF("Hold CREATE + PS on the controller until the light bar blinks to pair,");
	LOG_INF("or press PS on an already paired controller");

	k_work_reschedule(&scan_work, K_NO_WAIT);

	return 0;
}
```

## src/dualsense.c
```c
/*
 * DualSense / DualSense Edge input report parser.
 *
 * Report layouts follow the Linux hid-playstation driver, the DualSense Edge
 * Fn/back button bits follow SDL's PS5 HIDAPI driver.
 *
 * SPDX-License-Identifier: Apache-2.0
 */

#include <stdlib.h>

#include <zephyr/kernel.h>
#include <zephyr/logging/log.h>
#include <zephyr/sys/printk.h>
#include <zephyr/sys/util.h>

#include "dualsense.h"
#include "hid_host.h"
#include "link.h"

LOG_MODULE_REGISTER(dualsense, LOG_LEVEL_INF);

/*
 * Basic report, the only one sent over Bluetooth after connecting:
 *   ID, LX, LY, RX, RY, buttons[3], L2, R2
 */
#define DS_REPORT_BASIC          0x01
#define DS_BASIC_STICKS_OFFSET   1
#define DS_BASIC_BUTTONS_OFFSET  5
#define DS_BASIC_TRIGGERS_OFFSET 8
#define DS_BASIC_MIN_LEN         10

/*
 * Full report over Bluetooth, sent once the calibration feature report has
 * been read:
 *   ID, sequence tag, LX, LY, RX, RY, L2, R2, counter, buttons[4], ...
 */
#define DS_REPORT_FULL_BT          0x31
#define DS_FULL_BT_STICKS_OFFSET   2
#define DS_FULL_BT_TRIGGERS_OFFSET 6
#define DS_FULL_BT_BUTTONS_OFFSET  9
#define DS_FULL_BT_MIN_LEN         12

#define DS_FEATURE_REPORT_CALIBRATION 0x05

#define DS_BUTTONS0_HAT_MASK 0x0f
/* buttons[2] of the basic report carries a counter in its upper bits */
#define DS_BASIC_BUTTONS2_MASK 0x03

/* Stick axes rest at mid-scale, ignore the jitter of a stick left alone */
#define DS_STICK_CENTER   0x80
#define DS_STICK_DEADZONE 10
/* Smallest analog change worth printing, keeps sensor noise off the console */
#define DS_ANALOG_MIN_DELTA 4
/* Per control; the console cannot keep up with every single report */
#define DS_ANALOG_PRINT_INTERVAL_MS 50

/*
 * Bit positions mirror buttons[0..2] of the input report, except for the low
 * nibble of buttons[0], where the hat switch is expanded into four d-pad bits.
 */
enum ds_button {
	DS_BTN_DPAD_UP,
	DS_BTN_DPAD_RIGHT,
	DS_BTN_DPAD_DOWN,
	DS_BTN_DPAD_LEFT,
	DS_BTN_SQUARE,
	DS_BTN_CROSS,
	DS_BTN_CIRCLE,
	DS_BTN_TRIANGLE,

	DS_BTN_L1,
	DS_BTN_R1,
	DS_BTN_L2,
	DS_BTN_R2,
	DS_BTN_CREATE,
	DS_BTN_OPTIONS,
	DS_BTN_L3,
	DS_BTN_R3,

	DS_BTN_PS,
	DS_BTN_TOUCHPAD,
	DS_BTN_MUTE,
	DS_BTN_RESERVED,
	/* DualSense Edge only */
	DS_BTN_FN_LEFT,
	DS_BTN_FN_RIGHT,
	DS_BTN_BACK_LEFT,
	DS_BTN_BACK_RIGHT,

	DS_BTN_COUNT,
};

static const char *const button_names[DS_BTN_COUNT] = {
	[DS_BTN_DPAD_UP] = "D-PAD UP",
	[DS_BTN_DPAD_RIGHT] = "D-PAD RIGHT",
	[DS_BTN_DPAD_DOWN] = "D-PAD DOWN",
	[DS_BTN_DPAD_LEFT] = "D-PAD LEFT",
	[DS_BTN_SQUARE] = "SQUARE",
	[DS_BTN_CROSS] = "CROSS",
	[DS_BTN_CIRCLE] = "CIRCLE",
	[DS_BTN_TRIANGLE] = "TRIANGLE",
	[DS_BTN_L1] = "L1",
	[DS_BTN_R1] = "R1",
	[DS_BTN_L2] = "L2",
	[DS_BTN_R2] = "R2",
	[DS_BTN_CREATE] = "CREATE",
	[DS_BTN_OPTIONS] = "OPTIONS",
	[DS_BTN_L3] = "L3",
	[DS_BTN_R3] = "R3",
	[DS_BTN_PS] = "PS",
	[DS_BTN_TOUCHPAD] = "TOUCHPAD",
	[DS_BTN_MUTE] = "MUTE",
	[DS_BTN_FN_LEFT] = "FN LEFT",
	[DS_BTN_FN_RIGHT] = "FN RIGHT",
	[DS_BTN_BACK_LEFT] = "BACK LEFT",
	[DS_BTN_BACK_RIGHT] = "BACK RIGHT",
};

/* Hat switch: 0 = up, then clockwise in 45 degree steps, 8 = released */
static const uint8_t hat_to_dpad[] = {
	BIT(DS_BTN_DPAD_UP),
	BIT(DS_BTN_DPAD_UP) | BIT(DS_BTN_DPAD_RIGHT),
	BIT(DS_BTN_DPAD_RIGHT),
	BIT(DS_BTN_DPAD_RIGHT) | BIT(DS_BTN_DPAD_DOWN),
	BIT(DS_BTN_DPAD_DOWN),
	BIT(DS_BTN_DPAD_DOWN) | BIT(DS_BTN_DPAD_LEFT),
	BIT(DS_BTN_DPAD_LEFT),
	BIT(DS_BTN_DPAD_LEFT) | BIT(DS_BTN_DPAD_UP),
};

/* Last printed state of a stick */
struct ds_stick {
	int x;
	int y;
	uint32_t printed_at;
};

/* Last printed state of a trigger */
struct ds_trigger {
	int value;
	uint32_t printed_at;
};

static uint32_t prev_buttons;
static struct ds_stick left_stick;
static struct ds_stick right_stick;
static struct ds_trigger l2_trigger;
static struct ds_trigger r2_trigger;
static bool full_report_seen;

static uint32_t decode_buttons(const uint8_t *raw, uint8_t buttons2_mask)
{
	uint8_t hat = raw[0] & DS_BUTTONS0_HAT_MASK;
	uint32_t buttons;

	buttons = (raw[0] & ~DS_BUTTONS0_HAT_MASK) | (raw[1] << 8) |
		  ((uint32_t)(raw[2] & buttons2_mask) << 16);
	buttons &= ~BIT(DS_BTN_RESERVED);

	if (hat < ARRAY_SIZE(hat_to_dpad)) {
		buttons |= hat_to_dpad[hat];
	}

	return buttons;
}

static void print_button_changes(uint32_t buttons)
{
	uint32_t changed = buttons ^ prev_buttons;

	for (int i = 0; i < DS_BTN_COUNT; i++) {
		if (changed & BIT(i)) {
			printk("[DualSense] %s %s\n", button_names[i],
			       (buttons & BIT(i)) ? "pressed" : "released");
		}
	}

	prev_buttons = buttons;
}

static bool analog_changed(int value, int printed)
{
	if (value == printed) {
		return false;
	}

	/* Never leave a stale value on the console once the control is at rest */
	if (value == 0) {
		return true;
	}

	return abs(value - printed) >= DS_ANALOG_MIN_DELTA;
}

static int stick_axis(uint8_t raw)
{
	int value = raw - DS_STICK_CENTER;

	return (abs(value) < DS_STICK_DEADZONE) ? 0 : value;
}

/*
 * Prints each axis as an offset from the center: 0 = centered, about +/-127 at
 * the end stops, right and up are positive.
 */
static void print_stick_change(const char *name, struct ds_stick *stick, const uint8_t *raw,
			       uint32_t now)
{
	int x = stick_axis(raw[0]);
	/* The report has the Y axis pointing down */
	int y = -stick_axis(raw[1]);

	if (now - stick->printed_at < DS_ANALOG_PRINT_INTERVAL_MS) {
		return;
	}

	if (!analog_changed(x, stick->x) && !analog_changed(y, stick->y)) {
		return;
	}

	printk("[DualSense] %s x = %d, y = %d\n", name, x, y);

	stick->x = x;
	stick->y = y;
	stick->printed_at = now;
}

/* Prints 0 (released) .. 255 (fully pressed) */
static void print_trigger_change(const char *name, struct ds_trigger *trigger, uint8_t value,
				 uint32_t now)
{
	if (now - trigger->printed_at < DS_ANALOG_PRINT_INTERVAL_MS) {
		return;
	}

	if (!analog_changed(value, trigger->value) &&
	    !(value == UINT8_MAX && trigger->value != UINT8_MAX)) {
		return;
	}

	printk("[DualSense] %s = %d\n", name, value);

	trigger->value = value;
	trigger->printed_at = now;
}

static void handle_state(const uint8_t *sticks, const uint8_t *triggers, uint32_t buttons)
{
	uint32_t now = k_uptime_get_32();

	/* The emulator board gets every state, unfiltered; the console filtering
	   below is only there to keep the log readable. */
	link_send_state(buttons, sticks, triggers);

	print_button_changes(buttons);
	print_stick_change("LEFT STICK", &left_stick, &sticks[0], now);
	print_stick_change("RIGHT STICK", &right_stick, &sticks[2], now);
	print_trigger_change("L2", &l2_trigger, triggers[0], now);
	print_trigger_change("R2", &r2_trigger, triggers[1], now);
}

void dualsense_reset(void)
{
	prev_buttons = 0;
	left_stick = (struct ds_stick){0};
	right_stick = (struct ds_stick){0};
	l2_trigger = (struct ds_trigger){0};
	r2_trigger = (struct ds_trigger){0};
	full_report_seen = false;

	/* Whatever the controller was holding when it went away must not stay
	   pressed in the emulator. */
	link_send_idle();
}

int dualsense_enable_full_report(void)
{
	/* Reading the calibration data is what switches the report format */
	return hid_host_get_report(HID_REPORT_TYPE_FEATURE, DS_FEATURE_REPORT_CALIBRATION);
}

void dualsense_handle_input_report(const uint8_t *report, size_t len)
{
	switch (report[0]) {
	case DS_REPORT_BASIC:
		if (len < DS_BASIC_MIN_LEN) {
			return;
		}

		handle_state(&report[DS_BASIC_STICKS_OFFSET], &report[DS_BASIC_TRIGGERS_OFFSET],
			     decode_buttons(&report[DS_BASIC_BUTTONS_OFFSET],
					    DS_BASIC_BUTTONS2_MASK));
		break;
	case DS_REPORT_FULL_BT:
		if (len < DS_FULL_BT_MIN_LEN) {
			return;
		}

		if (!full_report_seen) {
			full_report_seen = true;
			LOG_INF("Full input report active");
		}

		handle_state(&report[DS_FULL_BT_STICKS_OFFSET],
			     &report[DS_FULL_BT_TRIGGERS_OFFSET],
			     decode_buttons(&report[DS_FULL_BT_BUTTONS_OFFSET], 0xff));
		break;
	default:
		LOG_DBG("Unhandled input report 0x%02x (%u bytes)", report[0], (unsigned int)len);
		break;
	}
}
```

## src/dualsense.h
```c
/*
 * DualSense / DualSense Edge input report parser.
 *
 * SPDX-License-Identifier: Apache-2.0
 */

#ifndef DUALSENSE_H_
#define DUALSENSE_H_

#include <stddef.h>
#include <stdint.h>

/** Forget the controller state, call when a controller (dis)connects. */
void dualsense_reset(void);

/**
 * Ask the controller for its full input report. Until then it only sends the
 * basic report, which lacks the mute button and the Edge Fn/back buttons.
 * To be called once the HID channels are up.
 */
int dualsense_enable_full_report(void);

/**
 * Parse an input report (report[0] is the report ID), print button changes
 * and stick/trigger movement.
 */
void dualsense_handle_input_report(const uint8_t *report, size_t len);

#endif /* DUALSENSE_H_ */
```

## src/hid_host.c
```c
/*
 * Minimal Bluetooth Classic HID host (HIDP over L2CAP) for a single device.
 *
 * Zephyr has no HID host profile for BR/EDR, so the two HID channels are
 * handled directly on top of L2CAP:
 *   PSM 0x0011 - control   (GET_REPORT/SET_REPORT, handshakes)
 *   PSM 0x0013 - interrupt (input/output reports)
 *
 * SPDX-License-Identifier: Apache-2.0
 */

#include <errno.h>
#include <string.h>

#include <zephyr/kernel.h>
#include <zephyr/logging/log.h>
#include <zephyr/net_buf.h>
#include <zephyr/bluetooth/bluetooth.h>
#include <zephyr/bluetooth/conn.h>
#include <zephyr/bluetooth/l2cap.h>

#include "hid_host.h"

LOG_MODULE_REGISTER(hid_host, LOG_LEVEL_INF);

#define HID_PSM_CTRL 0x0011
#define HID_PSM_INTR 0x0013

/* HIDP header: transaction type in the high nibble, parameter in the low one */
#define HIDP_HDR(type, param) (((type) << 4) | (param))
#define HIDP_HDR_TYPE(hdr)    ((hdr) >> 4)
#define HIDP_HDR_PARAM(hdr)   ((hdr) & 0x0f)

#define HIDP_TYPE_HANDSHAKE   0x0
#define HIDP_TYPE_HID_CONTROL 0x1
#define HIDP_TYPE_GET_REPORT  0x4
#define HIDP_TYPE_DATA        0xa

#define HIDP_HANDSHAKE_SUCCESSFUL       0x0
#define HIDP_CTRL_VIRTUAL_CABLE_UNPLUG  0x5

/* Only short control requests are sent, never output reports. */
#define HID_TX_MTU 16

NET_BUF_POOL_FIXED_DEFINE(hid_tx_pool, 2, BT_L2CAP_BUF_SIZE(HID_TX_MTU),
			  CONFIG_BT_CONN_TX_USER_DATA_SIZE, NULL);

static const struct hid_host_cb *host_cb;

static struct bt_l2cap_br_chan ctrl_chan;
static struct bt_l2cap_br_chan intr_chan;

static bool ctrl_up;
static bool intr_up;
/* The channels are opened by us, not by the device */
static bool initiator;
/* closed() is still owed to the application */
static bool session_open;

static const struct bt_l2cap_chan_ops ctrl_ops;
static const struct bt_l2cap_chan_ops intr_ops;

static struct bt_l2cap_chan *chan_prepare(struct bt_l2cap_br_chan *br_chan,
					  const struct bt_l2cap_chan_ops *ops)
{
	(void)memset(br_chan, 0, sizeof(*br_chan));
	br_chan->chan.ops = ops;
	br_chan->rx.mtu = BT_L2CAP_RX_MTU;
	br_chan->required_sec_level = BT_SECURITY_L2;

	return &br_chan->chan;
}

static void session_closed(void)
{
	if (!session_open) {
		return;
	}

	session_open = false;

	if (host_cb->closed) {
		host_cb->closed();
	}
}

static void ctrl_connected(struct bt_l2cap_chan *chan)
{
	int err;

	LOG_INF("HID control channel connected");
	ctrl_up = true;

	if (!initiator) {
		/* The device opens the interrupt channel on its own */
		return;
	}

	err = bt_l2cap_chan_connect(chan->conn, chan_prepare(&intr_chan, &intr_ops),
				    HID_PSM_INTR);
	if (err) {
		LOG_ERR("Failed to open HID interrupt channel (err %d)", err);
		bt_l2cap_chan_disconnect(chan);
	}
}

static void ctrl_disconnected(struct bt_l2cap_chan *chan)
{
	LOG_INF("HID control channel disconnected");
	ctrl_up = false;
	session_closed();
}

static int ctrl_recv(struct bt_l2cap_chan *chan, struct net_buf *buf)
{
	uint8_t hdr;

	if (buf->len < 1) {
		return 0;
	}

	hdr = buf->data[0];

	switch (HIDP_HDR_TYPE(hdr)) {
	case HIDP_TYPE_HANDSHAKE:
		if (HIDP_HDR_PARAM(hdr) != HIDP_HANDSHAKE_SUCCESSFUL) {
			LOG_WRN("HIDP handshake error 0x%x", HIDP_HDR_PARAM(hdr));
		}
		break;
	case HIDP_TYPE_HID_CONTROL:
		if (HIDP_HDR_PARAM(hdr) == HIDP_CTRL_VIRTUAL_CABLE_UNPLUG) {
			LOG_INF("Device requested virtual cable unplug");
		}
		break;
	case HIDP_TYPE_DATA:
		/* Reply to GET_REPORT */
		if (buf->len >= 2) {
			LOG_INF("Got report type %u id 0x%02x (%u bytes)", HIDP_HDR_PARAM(hdr),
				buf->data[1], buf->len - 1);
		}
		break;
	default:
		LOG_DBG("Unhandled HIDP header 0x%02x", hdr);
		break;
	}

	return 0;
}

static void intr_connected(struct bt_l2cap_chan *chan)
{
	LOG_INF("HID interrupt channel connected");
	intr_up = true;

	if (ctrl_up && host_cb->ready) {
		host_cb->ready();
	}
}

static void intr_disconnected(struct bt_l2cap_chan *chan)
{
	LOG_INF("HID interrupt channel disconnected");
	intr_up = false;
	session_closed();
}

static int intr_recv(struct bt_l2cap_chan *chan, struct net_buf *buf)
{
	if (buf->len < 2 ||
	    buf->data[0] != HIDP_HDR(HIDP_TYPE_DATA, HID_REPORT_TYPE_INPUT)) {
		return 0;
	}

	if (host_cb->input_report) {
		host_cb->input_report(&buf->data[1], buf->len - 1);
	}

	return 0;
}

static const struct bt_l2cap_chan_ops ctrl_ops = {
	.connected = ctrl_connected,
	.disconnected = ctrl_disconnected,
	.recv = ctrl_recv,
};

static const struct bt_l2cap_chan_ops intr_ops = {
	.connected = intr_connected,
	.disconnected = intr_disconnected,
	.recv = intr_recv,
};

static int hid_accept(struct bt_conn *conn, struct bt_l2cap_server *server,
		      struct bt_l2cap_chan **chan)
{
	if (server->psm == HID_PSM_CTRL) {
		if (!hid_host_is_idle()) {
			return -ENOMEM;
		}

		initiator = false;
		session_open = true;
		*chan = chan_prepare(&ctrl_chan, &ctrl_ops);

		return 0;
	}

	/* The interrupt channel has to follow control on the same ACL link */
	if (intr_chan.chan.conn || ctrl_chan.chan.conn != conn) {
		return -ENOMEM;
	}

	*chan = chan_prepare(&intr_chan, &intr_ops);

	return 0;
}

static struct bt_l2cap_server ctrl_server = {
	.psm = HID_PSM_CTRL,
	.sec_level = BT_SECURITY_L2,
	.accept = hid_accept,
};

static struct bt_l2cap_server intr_server = {
	.psm = HID_PSM_INTR,
	.sec_level = BT_SECURITY_L2,
	.accept = hid_accept,
};

int hid_host_init(const struct hid_host_cb *cb)
{
	int err;

	if (!cb) {
		return -EINVAL;
	}

	host_cb = cb;

	err = bt_l2cap_br_server_register(&ctrl_server);
	if (err) {
		return err;
	}

	return bt_l2cap_br_server_register(&intr_server);
}

bool hid_host_is_idle(void)
{
	return !ctrl_chan.chan.conn && !intr_chan.chan.conn;
}

int hid_host_connect(struct bt_conn *conn)
{
	int err;

	if (!hid_host_is_idle()) {
		return -EBUSY;
	}

	initiator = true;
	session_open = true;

	err = bt_l2cap_chan_connect(conn, chan_prepare(&ctrl_chan, &ctrl_ops), HID_PSM_CTRL);
	if (err) {
		session_open = false;
	}

	return err;
}

int hid_host_get_report(uint8_t type, uint8_t id)
{
	struct net_buf *buf;
	int err;

	if (!ctrl_up) {
		return -ENOTCONN;
	}

	buf = net_buf_alloc(&hid_tx_pool, K_NO_WAIT);
	if (!buf) {
		return -ENOBUFS;
	}

	net_buf_reserve(buf, BT_L2CAP_CHAN_SEND_RESERVE);
	net_buf_add_u8(buf, HIDP_HDR(HIDP_TYPE_GET_REPORT, type));
	net_buf_add_u8(buf, id);

	err = bt_l2cap_chan_send(&ctrl_chan.chan, buf);
	if (err < 0) {
		net_buf_unref(buf);
		return err;
	}

	return 0;
}
```

## src/hid_host.h
```c
/*
 * Minimal Bluetooth Classic HID host (HIDP over L2CAP) for a single device.
 *
 * SPDX-License-Identifier: Apache-2.0
 */

#ifndef HID_HOST_H_
#define HID_HOST_H_

#include <stdbool.h>
#include <stddef.h>
#include <stdint.h>

#include <zephyr/bluetooth/conn.h>

/* HIDP report types (Bluetooth HID Profile 1.1, section 3.1.2.3) */
#define HID_REPORT_TYPE_INPUT   0x01
#define HID_REPORT_TYPE_OUTPUT  0x02
#define HID_REPORT_TYPE_FEATURE 0x03

/* All callbacks are invoked from the Bluetooth RX context. */
struct hid_host_cb {
	/** Both the control and the interrupt channel are connected. */
	void (*ready)(void);

	/** Input report from the interrupt channel, report[0] is the report ID. */
	void (*input_report)(const uint8_t *report, size_t len);

	/** The HID session ended, called once per session. */
	void (*closed)(void);
};

/**
 * Register the HID control/interrupt L2CAP servers, so a bonded device can
 * open the channels itself when it reconnects.
 */
int hid_host_init(const struct hid_host_cb *cb);

/**
 * Open the HID channels from the host side. Triggers pairing and encryption
 * first when the link is not secured yet.
 */
int hid_host_connect(struct bt_conn *conn);

/** True when neither HID channel is in use. */
bool hid_host_is_idle(void);

/** Send GET_REPORT on the control channel. */
int hid_host_get_report(uint8_t type, uint8_t id);

#endif /* HID_HOST_H_ */
```

## src/link.c
```c
/*
 * Binary pad state link to the emulator board (i.MX RT1050).
 *
 * The emulator cannot use the console output, so the controller state also goes
 * out as a fixed 13 byte frame on UART2 (GPIO17 = TX, GPIO16 = RX on a
 * DevKitC). The receiving side is source/gamepad.c in the psxe_embedded
 * project, which documents the frame and the wiring.
 *
 * Frame: a5 5a  buttons[0..2]  lx ly rx ry  l2 r2  seq  xor(bytes 2..11)
 *
 * The button bitmap is passed on exactly as the DualSense reports it; mapping it
 * to a PlayStation controller is the emulator's business, not ours.
 *
 * SPDX-License-Identifier: Apache-2.0
 */

#include <string.h>

#include <zephyr/device.h>
#include <zephyr/drivers/uart.h>
#include <zephyr/kernel.h>
#include <zephyr/logging/log.h>

#include "link.h"

LOG_MODULE_REGISTER(link, LOG_LEVEL_INF);

#define LINK_UART_NODE DT_NODELABEL(uart2)

#define LINK_FRAME_LEN 13
#define LINK_SYNC0 0xa5
#define LINK_SYNC1 0x5a

/* Stick and trigger movement alone is not worth a frame more often than this */
#define LINK_ANALOG_INTERVAL_MS 8
/* Repeat an unchanged state at least this often, as a sign of life */
#define LINK_HEARTBEAT_MS 200

#define LINK_STICK_CENTER 0x80

static const struct device *link_uart;
static uint8_t last_payload[9]; /* bytes 2..10 of the last frame sent */
static uint32_t last_sent_ms;
static uint8_t sequence;
static bool have_sent;

void link_init(void)
{
	link_uart = DEVICE_DT_GET(LINK_UART_NODE);

	if (!device_is_ready(link_uart)) {
		LOG_ERR("Pad link UART not ready, the emulator board will see nothing");
		link_uart = NULL;
		return;
	}

	LOG_INF("Pad link up on " DT_NODE_FULL_NAME(LINK_UART_NODE));
}

static void link_write(const uint8_t *payload)
{
	uint8_t frame[LINK_FRAME_LEN];
	uint8_t check = 0;

	frame[0] = LINK_SYNC0;
	frame[1] = LINK_SYNC1;

	memcpy(&frame[2], payload, 9);

	frame[11] = sequence++;

	for (int i = 2; i < LINK_FRAME_LEN - 1; i++) {
		check ^= frame[i];
	}

	frame[LINK_FRAME_LEN - 1] = check;

	for (int i = 0; i < LINK_FRAME_LEN; i++) {
		uart_poll_out(link_uart, frame[i]);
	}

	memcpy(last_payload, payload, 9);
	last_sent_ms = k_uptime_get_32();
	have_sent = true;
}

void link_send_state(uint32_t buttons, const uint8_t *sticks, const uint8_t *triggers)
{
	if (!link_uart) {
		return;
	}

	uint8_t payload[9];

	payload[0] = (uint8_t)(buttons & 0xff);
	payload[1] = (uint8_t)((buttons >> 8) & 0xff);
	payload[2] = (uint8_t)((buttons >> 16) & 0xff);
	payload[3] = sticks[0];
	payload[4] = sticks[1];
	payload[5] = sticks[2];
	payload[6] = sticks[3];
	payload[7] = triggers[0];
	payload[8] = triggers[1];

	if (!have_sent) {
		link_write(payload);
		return;
	}

	const bool buttons_changed = memcmp(&payload[0], &last_payload[0], 3) != 0;
	const bool analog_changed = memcmp(&payload[3], &last_payload[3], 6) != 0;
	const uint32_t idle_ms = k_uptime_get_32() - last_sent_ms;

	/* A press or a release must never wait: it may be shorter than the
	 * analog interval and losing it would be felt in the game.
	 */
	if (buttons_changed) {
		link_write(payload);
		return;
	}

	if (analog_changed && (idle_ms >= LINK_ANALOG_INTERVAL_MS)) {
		link_write(payload);
		return;
	}

	if (idle_ms >= LINK_HEARTBEAT_MS) {
		link_write(payload);
	}
}

void link_send_idle(void)
{
	if (!link_uart) {
		return;
	}

	const uint8_t payload[9] = {
		0, 0, 0,
		LINK_STICK_CENTER, LINK_STICK_CENTER, LINK_STICK_CENTER, LINK_STICK_CENTER,
		0, 0,
	};

	link_write(payload);
}
```

## src/link.h
```c
/*
 * Binary pad state link to the emulator board (i.MX RT1050).
 *
 * SPDX-License-Identifier: Apache-2.0
 */

#ifndef LINK_H_
#define LINK_H_

#include <stdint.h>

/** Brings up the UART the emulator board listens on. */
void link_init(void);

/**
 * Forwards one controller state. Button changes go out immediately, stick and
 * trigger movement is rate limited, and an unchanged state is repeated now and
 * then so the receiver can tell the link is alive.
 *
 * @param buttons  button bitmap, the layout of enum ds_button
 * @param sticks   LX, LY, RX, RY as they come off the report (0x80 centred)
 * @param triggers L2, R2 as they come off the report (0 .. 255)
 */
void link_send_state(uint32_t buttons, const uint8_t *sticks, const uint8_t *triggers);

/** Sends a released, centred state, for when the controller goes away. */
void link_send_idle(void);

#endif /* LINK_H_ */
```
